## Kconfig
```kconfig
# Copyright (c) 2020 The ZMK Contributors
# SPDX-License-Identifier: MIT

rsource "src/drivers/Kconfig"

DT_COMPAT_ZMK_INPUT_LISTENER_PS2 := zmk,input-listener-ps2
config ZMK_INPUT_LISTENER_PS2
        bool
        default $(dt_compat_enabled,$(DT_COMPAT_ZMK_INPUT_LISTENER_PS2))

DT_COMPAT_ZMK_BEHAVIOR_MOUSE_SETTING := zmk,behavior-mouse-setting
config ZMK_BEHAVIOR_MOUSE_SETTING
        bool
        default ZMK_INPUT_MOUSE_PS2 && $(dt_compat_enabled,$(DT_COMPAT_ZMK_BEHAVIOR_MOUSE_SETTING))
```

## dts/bindings/behaviors/zmk,behavior-mouse-scroll-mode.yaml
```yaml
description: Mouse scroll

compatible: "zmk,behavior-mouse-scroll-mode"

include: zero_param.yaml
```

## dts/bindings/zmk,input-accelerator.yaml
```yaml
description: |
  API that adjusts an input movement using a customizable acceleration curve.

compatible: "zmk,input-accelerator"

properties:
  acceleration-curve:
    type: string
    required: false
    default: none
    description: Which acceleration curve formula should be used. Currently, available options are "none", "sigmoid_accelaration_factor" and "sigmoid_output_speed". "none" will only apply the base acceleration factor, but no curve. "sigmoid_accelaration_factor" will accelerate the input speeds using a sigmoid function that generates an acceleration curve (best for mouse movement). And "sigmoid_output_speed" will apply the sigmoid function to the output speed (best for scroll movement).
    enum:
      - none
      - sigmoid
      - scroll

  acceleration-factor-base:
    type: int
    required: false
    default: 100
    description: The start of the curve's acceleration factor as a percentage. A value above 100 means the movement will be acelerated. Below 100 means it will be decelerated and 100 means the movement will not be changed. For example, the value 50 means that the acceleration will start at 50% and then rise to the maximum based on the other options...

  acceleration-factor-max:
    type: int
    required: false
    default: 150
    description: The maximum acceleration factor that will be used by the acceleration curve. The curve will rise from the base rate to this maximum rate. For example, if the base (or starting) rate is decelerated to 50% and the max is accelerated to 150%, then you have a total acceleration of 3x.

  acceleration-factor-rate:
    type: int
    required: false
    default: -1
    description: The rate at which the curve will rise from the base to the max acceleration factor. For the sigmoid curve a default of 0.2 will be used.

  acceleration-start-offset:
    type: int
    required: false
    default: 0
    description: The minimum input movement speed at which the acceleration should begin. Allows you to define a precise movement threshold during which no acceleration is applied.

  max-speed:
    type: int
    required: false
    default: -1
    description: The maximum movement speed that will be allowed. This is useful to prevent the mouse cursor from accelerating to a speed that you can't follow on the screen anymore.

  divisor:
    type: int
    required: false
    default: 1
    description: By how much the accelerated speed should be divided. Useful if you need to significantly reduce the speed of the mouse movement. For example, when you are converting mouse movement into scroll movement. Values of 10-20 are good for that purpose.

  enable-interval-based-speed:
    type: boolean
    description: Adjust the movement speed using the time interval between movements. Necessary for input devices that slow down their sending rate to report small movements, such as PS/2 mice and Trackpoints. Please set the sampling or polling rate with the `input-default-sending-rate` parameter.

  input-default-sending-rate:
    type: int
    required: false
    default: 100
    description: The rate per second of how often the input device is expected to send new movement data. It is required to correctly calculate the movement speed if `enable-interval-based-speed` is enabled.
```

## dts/bindings/zmk,input-listener.yaml
```yaml
description: |
  Listener to subscribe to input events and send HID updates after processing

compatible: "zmk,input-listener-ps2"

properties:
  device:
    type: phandle
    required: true
  xy-swap:
    type: boolean
  x-invert:
    type: boolean
  y-invert:
    type: boolean
  scale-multiplier:
    type: int
    default: 1
  scale-divisor:
    type: int
    default: 1
  move-accelerator:
    type: phandle
    required: false
  scroll-accelerator:
    type: phandle
    required: false
  layer-toggle:
    type: int
    default: -1
    required: false
    description: The layer that should be toggled when the mouse is moved.
  layer-toggle-delay-ms:
    type: int
    default: 250
    required: false
    description: How many miliseconds of mouse activity are required before the layer is toggled on.
  layer-toggle-timeout-ms:
    type: int
    default: 250
    required: false
    description: How many miliseconds of mouse inactivity are required before the layer is toggled off again.
  layer-toggle-require-prior-idle-ms:
    type: int
    default: -1
    description: Requires that no keys have been pressed for at least the specified time before the layer is activated. Allows you to prevent the activation of the mouse layer if the mouse device is moved is accidentally moved while typing.
  scroll-layers:
    type: array
    required: false
    description: On which layers the mouse movement should be converted into scroll movement.
  scroll-layers-reverse-direction-vertical:
    type: boolean
    required: false
    description: Swaps the direction of vertical scrolling (up becomes down and down becomes up). Useful on macOS with their "natural scrolling", which makes sense on trackpads, but not other mouse devices.
```

## dts/bindings/zmk,mouse-ps2.yaml
```yaml
description: PS2 mouse configuration

compatible: "zmk,mouse-ps2"

properties:
  ps2-device:
    type: phandle
    required: true
    description: |
      The ps2 device the mouse should use.

  rst-gpios:
    type: phandle-array
    required: false
    description: GPIO to which the RST pin of the device is connected and on which the Power-On-Reset will be performed.

  sampling-rate:
    type: int
    description: Adjusts the sensitivity setting on trackpoint devices. The allowed values are 10, 20, 40, 60, 80, 100, 200 and the default is 100.
    enum:
      - 10
      - 20
      - 40
      - 60
      - 80
      - 100
      - 200

  disable-clicking:
    type: boolean
    description: Disables clicking. Useful when using a PS2 driver that is prone to erros in transmissions to reduce accidental clicks.

  tp-press-to-select:
    type: boolean
    description: Enables mouse clicking by pressing hard on the trackpoint. Not all trackpoints support this feature.

  tp-press-to-select-threshold:
    type: int
    description: Adjusts how sensitive the press-to-select feature is. The range is 0 - 255 and the default is 8. You can also adjust this setting at runtime without recompiling using the &mms behavior. If this setting is enabled, then the runtime behavior won't be saved into the runtime settings.

  tp-sensitivity:
    type: int
    description: Adjusts the sensitivity setting on trackpoint devices. The range is 0 - 255 and the default is 128. You can also adjust this setting at runtime without recompiling using the &mms behavior. If this setting is enabled, then the runtime behavior won't be saved into the runtime settings.

  tp-neg-inertia:
    type: int
    description: Adjusts the negative inertia setting on trackpoint devices. The range is 0 - 255 and the default is 6. You can also adjust this setting at runtime without recompiling using the &mms behavior. If this setting is enabled, then the runtime behavior won't be saved into the runtime settings.

  tp-val6-upper-speed:
    type: int
    description: Adjusts the negative value0 upper plateau speed setting on trackpoint devices. The range is 0 - 255 and the default is 97. You can also adjust this setting at runtime without recompiling using the &mms behavior. If this setting is enabled, then the runtime behavior won't be saved into the runtime settings.

  layer-toggle:
    type: int
    required: false
    description: The layer that should be toggled when the mouse is moved.

  layer-toggle-delay-ms:
    type: int
    default: 250
    required: false
    description: How many miliseconds of mouse activity are required before the layer is toggled on.

  layer-toggle-timeout-ms:
    type: int
    default: 250
    required: false
    description: How many miliseconds of mouse inactivity are required before the layer is toggled off again.
```

## dts/bindings/zmk,ps2-mouse.yaml
```yaml
description: PS2 mouse configuration

compatible: "zmk,ps2-mouse"

properties:
  label:
    type: string
    required: true

  ps2-device:
    type: phandle
    required: true
    description: |
      The ps2 device the mouse should use.

  rst-gpios:
    type: phandle-array
    required: false
    description: GPIO to which the RST pin of the device is connected and on which the Power-On-Reset will be performed.
```

## src/drivers/Kconfig
```kconfig
# Copyright (c) 2020 The ZMK Contributors
# SPDX-License-Identifier: MIT

rsource "ps2/Kconfig"
rsource "input/Kconfig"
```

## src/drivers/ps2/Kconfig.gpio
```kconfig
# Copyright (c) 2017 Linaro Ltd.
# SPDX-License-Identifier: Apache-2.0

DT_COMPAT_PS2_GPIO := gpio-ps2

config PS2_GPIO
	bool "GPIO bit banging PS/2 support"
	default $(dt_compat_enabled,$(DT_COMPAT_PS2_GPIO))
	help
	  Enable software driven (bit banging) PS/2 support using GPIO pins

if PS2_GPIO

# PS/2 events must be processed within 30-50us. Therefore we shift the
# BT_CTLR_LLL_PRIO from 0 to 1 and BT_CTLR_ULL_* priorities from 1 to 2.
# We then set the gpio priority to 0.
#
# On top of this, the following has to be added to the device tree:
# &gpiote {
# 	interrupts = < 0x6 0 >;
# };
#
# This allows the PS/2 interrupts to be triggered in time.

config BT_CTLR_ADVANCED_FEATURES
	default y

config BT_CTLR_LLL_PRIO
	default 1

config BT_CTLR_ULL_HIGH_PRIO
	default 2

config BT_CTLR_ULL_LOW_PRIO
	default 2

config PS2_GPIO_INTERRUPT_LOG_ENABLED
	bool "Enable extensive interrupt logging."
	default n

endif # PS2_GPIO
```

## src/drivers/ps2/Kconfig.uart
```kconfig
# Copyright (c) 2017 Linaro Ltd.
# SPDX-License-Identifier: Apache-2.0

DT_COMPAT_PS2_UART := uart-ps2

config PS2_UART
	bool "GPIO bit banging PS/2 support through UART"
	default $(dt_compat_enabled,$(DT_COMPAT_PS2_UART))
	select CONFIG_SERIAL
	select CONFIG_UART_ASYNC_API
	select CONFIG_UART_USE_RUNTIME_CONFIGURE
	help
	  Enable software driven (bit banging) PS/2 support using UART on GPIO pins
```

## src/mouse/Kconfig
```kconfig
# Copyright (c) 2023 The ZMK Contributors
# SPDX-License-Identifier: MIT

DT_COMPAT_ZMK_PS2_MOUSE := zmk,mouse-ps2

config ZMK_MOUSE_PS2
	bool
	default $(dt_compat_enabled,$(DT_COMPAT_ZMK_PS2_MOUSE))
    depends on (!ZMK_SPLIT || ZMK_SPLIT_ROLE_CENTRAL)
	select ZMK_MOUSE
    select PS2

if ZMK_MOUSE_PS2

config ZMK_MOUSE_PS2_ENABLE_ERROR_MITIGATION
    bool "Tries to mitigate transmission errors. Only useful when using a PS2 driver that is prone to miscommunication like the GPIO bitbanging driver."
	default n

endif # ZMK_MOUSE_PS2s
```
