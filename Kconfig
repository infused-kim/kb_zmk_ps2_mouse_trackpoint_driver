## Kconfig
```kconfig
# Copyright (c) 2020 The ZMK Contributors
# SPDX-License-Identifier: MIT

rsource "src/drivers/Kconfig"

DT_COMPAT_ZMK_BEHAVIOR_MOUSE_SETTING := zmk,behavior-mouse-setting
config ZMK_BEHAVIOR_MOUSE_SETTING
        bool
        default ZMK_INPUT_MOUSE_PS2 && $(dt_compat_enabled,$(DT_COMPAT_ZMK_BEHAVIOR_MOUSE_SETTING))

# Copy of ZMK's temp layer input processor (zmk,input-processor-temp-layer)
DT_COMPAT_ZMK_INPUT_PROCESSOR_TEMP_LAYER_DELAYED := zmk,input-processor-temp-layer-delayed
config ZMK_INPUT_PROCESSOR_TEMP_LAYER_DELAYED
        bool
        default ZMK_POINTING && (!ZMK_SPLIT || ZMK_SPLIT_ROLE_CENTRAL) && $(dt_compat_enabled,$(DT_COMPAT_ZMK_INPUT_PROCESSOR_TEMP_LAYER_DELAYED))

config ZMK_INPUT_PROCESSOR_TEMP_LAYER_DELAYED_MAX_ACTION_EVENTS
        int "Temporary Layer Delayed Input Processor Max Action Events"
        default 4
        depends on ZMK_INPUT_PROCESSOR_TEMP_LAYER_DELAYED
```

## dts/bindings/input_processors/zmk,input-processor-temp-layer-delayed.yaml
```yaml
# Copyright (c) 2024, The ZMK Contributors
# SPDX-License-Identifier: MIT

description: |
  Input Processor for temporarily enabling a layer after input events.

  Copy of zmk,input-processor-temp-layer that can require a minimum duration
  of continuous movement before the layer is enabled.

compatible: "zmk,input-processor-temp-layer-delayed"

include: ip_two_param.yaml

properties:
  require-prior-idle-ms:
    type: int
    required: false
    default: 0
    description: Time in milliseconds that must pass after the last keystroke before the layer can be toggled

  excluded-positions:
    type: array
    required: false
    default: []
    description: Array of key positions that will NOT trigger layer deactivation when pressed

  require-movement-ms:
    type: int
    default: 0
    description: |
      Time in milliseconds the movement must last before the layer is enabled.
      Prevents enabling the layer when the pointing device is touched by
      accident, e.g. a TrackPoint while typing. 0 enables it on the first
      movement, like zmk,input-processor-temp-layer.

      A pause of more than 200 ms between two input events starts a new
      movement. TrackPoints send reports less often during slow movement.
```

## dts/bindings/zmk,input-accelerator.yaml
```yaml
description: |
  API that adjusts an input movement using a customizable acceleration curve.

  Can be used as `move-accelerator` of a `zmk,input-listener-accel` listener or
  as an input processor (`#input-processor-cells = <0>;`). A single node must
  not be used for both, because they share the acceleration state.

compatible: "zmk,input-accelerator"

include: ip_common.yaml

properties:
  "#input-processor-cells":
    type: int
    const: 0
    description: Set to 0 to use this accelerator as an input processor.

  acceleration-curve:
    type: string
    required: false
    default: none
    description: Which acceleration curve formula should be used. Available options are "none" and "sigmoid". "none" will only apply the base acceleration factor, but no curve. "sigmoid" will accelerate the input speeds using a sigmoid function that rises from the base to the max acceleration factor.
    enum:
      - none
      - sigmoid

  acceleration-base:
    type: int
    required: false
    default: 100
    description: Where the curve starts, as a percentage. It's the acceleration factor, or the gain in "gain" mode, at speeds below the start offset. A value above 100 means the movement will be accelerated. Below 100 means it will be decelerated and 100 means the movement will not be changed. For example, the value 50 means that the acceleration will start at 50% and then rise to `acceleration-cap`. The "none" curve only applies this value.

  acceleration-cap:
    type: int
    required: false
    default: 150
    description: Where the curve ends up, as a percentage. The curve rises from `acceleration-base` to this value. The "sigmoid" curve approaches it smoothly and never quite reaches it. For example, if the base is decelerated to 50% and the cap is accelerated to 150%, then you have a total acceleration of 3x.

  acceleration-rate:
    type: int
    required: false
    default: 20
    description: The rate at which the sigmoid curve will rise from the base to the cap, in hundredths. For example, the default of 20 means a rate of 0.2. Higher values make the curve steeper. Not used by the "none" curve.

  acceleration-start-offset:
    type: int
    required: false
    default: 0
    description: The minimum input movement speed at which the acceleration should begin. Allows you to define a precise movement threshold during which no acceleration is applied.

  acceleration-speed-cap:
    type: int
    required: false
    default: -1
    description: The maximum accelerated movement speed that will be allowed, in movement units per report at the `input-default-sending-rate`. The acceleration factor is lowered whenever the input speed multiplied by the factor would exceed it. This is useful to prevent the mouse cursor from accelerating to a speed that you can't follow on the screen anymore, for example when a TrackPoint is pressed very hard. Set to -1 to disable.

  enable-interval-based-speed:
    type: boolean
    description: Adjust the movement speed using the time interval between movements. Necessary for input devices that slow down their sending rate to report small movements, such as PS/2 mice and Trackpoints. Please set the sampling or polling rate with the `input-default-sending-rate` parameter.

  input-default-sending-rate:
    type: int
    required: false
    default: 100
    description: The rate per second of how often the input device is expected to send new movement data. It is required to correctly calculate the movement speed if `enable-interval-based-speed` is enabled.
```

## dts/bindings/zmk,input-listener-accel.yaml
```yaml
# Copyright (c) 2024 The ZMK Contributors
# SPDX-License-Identifier: MIT

description: |
  Listener to subscribe to input events and send HID updates after processing

  Copy of ZMK's v0.3 `zmk,input-listener`.

compatible: "zmk,input-listener-accel"

properties:
  device:
    type: phandle
    required: true
  input-processors:
    type: phandle-array

child-binding:
  description: "Listener overrides for certain layers"

  properties:
    layers:
      type: array
      required: true
    process-next:
      type: boolean
    input-processors:
      type: phandle-array
```
