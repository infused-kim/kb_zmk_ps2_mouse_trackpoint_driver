/*
 * Copyright (c) 2020 The ZMK Contributors
 *
 * SPDX-License-Identifier: MIT
 */

/ {
	behaviors {
		msm: behavior_mouse_scroll_mode {
			compatible = "zmk,behavior-mouse-scroll-mode";
			#binding-cells = <0>;
		};
	};
};
